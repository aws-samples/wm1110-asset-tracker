## boards/arm/wio_tracker_1110/Kconfig.board
```kconfig
# nRF52840 DK NRF52840 board configuration

# Copyright (c) 2016 Nordic Semiconductor ASA
# SPDX-License-Identifier: Apache-2.0

config BOARD_WIO_TRACKER_1110
	bool "Wio Tracker 1110"
	depends on SOC_NRF52840_QIAA
```

## boards/arm/wio_tracker_1110/Kconfig.defconfig
```kconfig
# nRF52840 DK NRF52840 board configuration

# Copyright (c) 2016 Nordic Semiconductor ASA
# SPDX-License-Identifier: Apache-2.0

if BOARD_WIO_TRACKER_1110

config BOARD
	default "wio_tracker_1110"

config BT_CTLR
	default BT

endif # BOARD_WIO_TRACKER_1110

if USB_DEVICE_STACK

config UART_CONSOLE
	default CONSOLE

config USB_DEVICE_INITIALIZE_AT_BOOT
	default y

endif # USB_DEVICE_STACK
```

## boards/seeed/wio_tracker_1110/Kconfig.defconfig
```kconfig
# Seeed Wio Tracker 1110 board configuration

# Copyright (c) 2024 Seeed Studio
# SPDX-License-Identifier: Apache-2.0

if BOARD_WIO_TRACKER_1110

config BT_CTLR
	default BT

endif # BOARD_WIO_TRACKER_1110

if USB_DEVICE_STACK

config UART_CONSOLE
	default CONSOLE

config USB_DEVICE_INITIALIZE_AT_BOOT
	default y

endif # USB_DEVICE_STACK
```

## boards/seeed/wio_tracker_1110/Kconfig.wio_tracker_1110
```kconfig
# Seeed Wio Tracker 1110 board configuration

# Copyright (c) 2024 Seeed Studio
# SPDX-License-Identifier: Apache-2.0

config BOARD_WIO_TRACKER_1110
	select SOC_NRF52840_QIAA
```

## boards/seeed/wio_tracker_1110/wio_tracker_1110_nrf52840_defconfig
```kconfig
# SPDX-License-Identifier: Apache-2.0

# Enable MPU
CONFIG_ARM_MPU=y

# Enable hardware stack protection
CONFIG_HW_STACK_PROTECTION=y

# enable GPIO
CONFIG_GPIO=y

# enable uart driver
CONFIG_SERIAL=y

# enable console
CONFIG_CONSOLE=y

# Logger cannot use itself to log
CONFIG_USB_CDC_ACM_LOG_LEVEL_OFF=y

# enable USB
CONFIG_USB_DEVICE_STACK=y

# additional board options
CONFIG_GPIO_AS_PINRESET=y

CONFIG_PINCTRL=y
```
